/{
    alphaled {
        #address-cells = <1>;
        #size-cells = <1>;
        compatible = "alphaled-led";
        status = "okay";
        reg = < 
            0X020C406C 0X04 /* CCM_CCGR1_BASE */
            0X020E0068 0X04 /* SW_MUX_GPIO1_IO03_BASE */
            0X020E02F4 0X04 /* SW_PAD_GPIO1_IO03_BASE */
            0X0209C000 0X04 /* GPIO1_DR_BASE */
            0X0209C004 0X04 /* GPIO1_GDIR_BASE */
        >;
    };
}